/*
 * Copyright (c) 2024
 *
 * SPDX-License-Identifier: MIT
 */

#include "hardcode.dtsi"

&kscan0 {
    col-gpios
        = <&pro_micro 4 GPIO_ACTIVE_HIGH>
        , <&pro_micro 3 GPIO_ACTIVE_HIGH>
        , <&pro_micro 2 GPIO_ACTIVE_HIGH>
        , <&pro_micro 14 GPIO_ACTIVE_HIGH>
        , <&pro_micro 15 GPIO_ACTIVE_HIGH>
        , <&pro_micro 18 GPIO_ACTIVE_HIGH>
        ;
};
